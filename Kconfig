## Kconfig
```kconfig
menu "Audio Framework"

config AUDIO_FRAMEWORK
    bool "Enable Audio Framework"
    default y
    select FPU if CPU_HAS_FPU # Only enable FPU if the CPU supports it

if AUDIO_FRAMEWORK

config AUDIO_BLOCK_SAMPLES
    int "Samples per Block"
    default 128
    help
      Number of samples in one audio chunk (e.g. 128 shorts).

config AUDIO_SAMPLE_RATE
    int "Sample Rate (Hz)"
    default 48000

config AUDIO_MEM_SLAB_COUNT
    int "Number of Memory Slabs"
    default 20
    help
      Total number of audio blocks available in the memory pool.
      Increase this if you have many nodes or buffers.

config AUDIO_THREAD_STACK_SIZE
    int "Default Node Stack Size"
    default 1024

config AUDIO_THREAD_PRIORITY
    int "Default Node Priority"
    default 5

endif # AUDIO_FRAMEWORK
endmenu
```

## tests/memory_check/testcase.yaml
```yaml
tests:
  audio.memory.allocation:
    tags: audio memory
    platform_allow: native_sim
    integration_platforms:
      - native_sim
```

## tests/node_sine/testcase.yaml
```yaml
tests:
  audio.node_sine:
    tags: audio node v2 generator sine
    platform_allow: native_sim qemu_cortex_m3
    integration_platforms:
      - native_sim
```

## tests/spectrum_analyzer_v2/testcase.yaml
```yaml
tests:
  audio.spectrum_analyzer_v2.native:
    tags: audio spectrum fft
    platform_allow: native_sim
    integration_platforms:
      - native_sim

  audio.spectrum_analyzer_v2.arm:
    tags: audio spectrum fft cmsis-dsp arm
    platform_allow: qemu_cortex_m3
    integration_platforms:
      - qemu_cortex_m3
```

## west.yml
```yaml
# Zephyr workspace manifest for z_audio_kit
# This file enables west workspace initialization for development and CI

manifest:
  version: "0.13"

  # West will fetch Zephyr and its dependencies
  remotes:
    - name: zephyrproject-rtos
      url-base: https://github.com/zephyrproject-rtos

  projects:
    - name: zephyr
      remote: zephyrproject-rtos
      revision: v3.6.0
      import:
        # Import Zephyr's west dependencies (HALs, modules, etc.)
        name-allowlist:
          - cmsis      # CMSIS Core headers
          - cmsis-dsp  # CMSIS-DSP library (for ARM FFT)
          - hal_stm32
          - hal_nxp
          - segger
          - TraceRecorder

  # Mark this repository as the manifest repository
  self:
    path: .
```
