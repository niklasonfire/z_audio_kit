## CMakeLists.txt
```
# deps/modules/z_audio_kit/samples/basic_sine/CMakeLists.txt

cmake_minimum_required(VERSION 3.20.0)

# 1. Zephyr Paket laden (MUSS vor project() stehen)
find_package(Zephyr REQUIRED HINTS $ENV{ZEPHYR_BASE})

# 2. Projekt definieren
project(basic_sine)

# 3. Quellcode hinzufügen
target_sources(app PRIVATE src/main.c)

# 4. Library einbinden
# Überprüft, ob die Library geladen wurde (via Zephyr Module System)
if(TARGET z_audio_kit)
    target_link_libraries(app PRIVATE z_audio_kit)
else()
    message(WARNING "z_audio_kit Target not found! Is the module path correct?")
endif()
```

## Kconfig
```
# deps/modules/z_audio_kit/samples/basic_sine/Kconfig

# WICHTIG: Lädt alle Zephyr-Basis-Symbole (Kernel, Boards, Console, etc.)
source "Kconfig.zephyr"

# Optional: Deine Sample-spezifischen Einstellungen
menu "Basic Sine Sample"
    config SAMPLE_SINE_FREQ
        int "Sine Frequency"
        default 440
endmenu
```

## prj.conf
```kconfig
# --- Zephyr Core ---
CONFIG_LOG=y
CONFIG_PRINTK=y
CONFIG_STDOUT_CONSOLE=y
# CONFIG_NATIVE_UART_0_ON_STDINOUT=y
CONFIG_SERIAL=y
# Audio benötigt oft Heap für die Blöcke (Memory Slabs nutzen intern Kernel-Objekte,
# aber falls du malloc im Init nutzt):
CONFIG_HEAP_MEM_POOL_SIZE=2048

# --- Dein Audio Kit aktivieren ---
# Der Name muss exakt mit dem in deinem z_audio_kit/Kconfig übereinstimmen!
CONFIG_AUDIO_FRAMEWORK=y

# --- Optionale Konfigurationen deiner Lib (Beispiele) ---
CONFIG_AUDIO_BLOCK_SAMPLES=128
CONFIG_AUDIO_SAMPLE_RATE=48000
# Reduce memory slab count for constrained targets like qemu_cortex_m3
CONFIG_AUDIO_MEM_SLAB_COUNT=4
CONFIG_AUDIO_THREAD_STACK_SIZE=512
```

## boards/qemu_cortex_m3.conf
```kconfig
# ARM-specific configuration for qemu_cortex_m3

# Enable FPU on ARM platform (moved from base prj.conf)
CONFIG_FPU=y
CONFIG_FPU_SHARING=y

# Enable CMSIS-DSP for spectrum_analyzer_v2 node
CONFIG_CMSIS_DSP=y
CONFIG_CMSIS_DSP_TRANSFORM=y
CONFIG_CMSIS_DSP_STATISTICS=y
```

## src/main.c
```c
#include <zephyr/kernel.h>
#include <zephyr/logging/log.h>
#include "audio_fw.h" // Dein Header

LOG_MODULE_REGISTER(main, LOG_LEVEL_INF);

/* Stack Sizes */
#define STACK_SIZE 1024
#define PRIORITY 5

/* Nodes */
struct audio_node source;
struct audio_node sink;

/* Thread Stacks */
K_THREAD_STACK_DEFINE(stack_src, STACK_SIZE);
K_THREAD_STACK_DEFINE(stack_sink, STACK_SIZE);

int main(void) {
    LOG_INF("Starte z_audio_kit Sample...");

#ifdef CONFIG_AUDIO_FRAMEWORK
    // 1. Init
    // Nutzt das Kconfig aus dem Sample, falls du es implementierst, sonst hardcoded
    node_sine_init(&source, 440.0f); 
    node_log_sink_init(&sink);

    // 2. Wiring
    source.out_fifo = &sink.in_fifo;

    // 3. Start
    audio_node_start(&source, stack_src);
    audio_node_start(&sink, stack_sink);
    
    LOG_INF("Pipeline läuft!");
#else
    LOG_ERR("Audio Framework ist nicht aktiviert! Check prj.conf");
#endif

    return 0;
}
```
