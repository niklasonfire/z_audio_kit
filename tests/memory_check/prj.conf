## CMakeLists.txt
```
cmake_minimum_required(VERSION 3.20.0)
find_package(Zephyr REQUIRED HINTS $ENV{ZEPHYR_BASE})
project(memory_test)

# WICHTIG: Falls "z_audio_kit" keine echte Library ist (sondern nur Source-Files via Zephyr Module),
# verursacht "target_link_libraries" Fehler.
# Besser ist es meist, es wegzulassen, wenn CONFIG_AUDIO_FRAMEWORK gesetzt ist.
# target_link_libraries(app PRIVATE z_audio_kit) <--- Im Zweifel auskommentieren/löschen

target_sources(app PRIVATE src/main.c)
```

## prj.conf
```kconfig
CONFIG_ZTEST=y
# CONFIG_ZTEST_NEW_API=y  <-- DIESE ZEILE LÖSCHEN!

# Dein Framework aktivieren
CONFIG_AUDIO_FRAMEWORK=y

# Test-Szenario: Wir fordern Speicher an
CONFIG_AUDIO_BLOCK_SAMPLES=128
CONFIG_HEAP_MEM_POOL_SIZE=16384

# Falls nötig (je nach Kconfig deines Moduls)
# CONFIG_AUDIO_NUM_BLOCK_BUFFERS=8
```

## boards/qemu_cortex_m3.conf
```kconfig
# Reduce memory usage for constrained qemu_cortex_m3 platform (64KB RAM)
CONFIG_HEAP_MEM_POOL_SIZE=8192
CONFIG_MAIN_STACK_SIZE=1024
CONFIG_IDLE_STACK_SIZE=256
```

## src/main.c
```c
#include <zephyr/kernel.h>
#include <zephyr/ztest.h>
#include <audio_fw.h> // Dein Header

// Setup: Läuft vor jedem Test
static void *setup(void) {
    return NULL;
}

ZTEST_SUITE(audio_memory, NULL, setup, NULL, NULL, NULL);

/**
 * @brief Testet, ob audio_block_alloc() einen gültigen Block MIT Datenpuffer liefert.
 * Das war dein OOM-Problem: Der Block war da, aber data war NULL.
 */
ZTEST(audio_memory, test_allocation_integrity) {
    struct audio_block *block = audio_block_alloc();

    // 1. Ist der Block an sich da?
    zassert_not_null(block, "Fehler: audio_block_alloc gab NULL zurück (Pool leer?)");

    // 2. Hat der Block Speicher für Samples? (Hier lag der Fehler!)
    zassert_not_null(block->data, "Fehler: block->data ist NULL! Slab-Konfiguration prüfen!");
    
    // 3. Stimmt die Länge?
    zassert_equal(block->data_len, 128, "Fehler: Blocklänge ist %d, erwartet 128", block->data_len);

    // Aufräumen
    audio_block_release(block);
}

/**
 * @brief Testet Stress: Können wir mehrere Blöcke holen?
 */
ZTEST(audio_memory, test_pool_capacity) {
    struct audio_block *blocks[4];
    int i;

    for(i=0; i<4; i++) {
        blocks[i] = audio_block_alloc();
        if (!blocks[i]) break;
    }

    // Wir erwarten, dass wir wenigstens 4 Blöcke für eine Pipeline bekommen
    zassert_equal(i, 4, "Konnte nur %d von 4 Blöcken allocieren. Pool zu klein!", i);

    // Alles zurückgeben
    for(int j=0; j<i; j++) {
        audio_block_release(blocks[j]);
    }
}
```
